## meta-evb/meta-evb-sifive/conf/layer.conf
```bitbake
# We have a conf and classes directory, add to BBPATH
BBPATH .= ":${LAYERDIR}"

BBFILE_COLLECTIONS += "evb-sifive"
BBFILE_PATTERN_evb-sifive = ""
BBFILE_PATTERN_IGNORE_EMPTY_evb-sifive =  "1"
LAYERSERIES_COMPAT_evb-sifive = "nanbield scarthgap"
```

## meta-evb/meta-evb-sifive/meta-evb-unleashed/conf/layer.conf
```bitbake
# We have a conf and classes directory, add to BBPATH
BBPATH .= ":${LAYERDIR}"

# We have recipes-* directories, add to BBFILES
BBFILES += "${LAYERDIR}/recipes-*/*/*.bb \
            ${LAYERDIR}/recipes-*/*/*.bbappend"

BBFILE_COLLECTIONS += "evb-unleashed"
BBFILE_PATTERN_evb-unleashed = "^${LAYERDIR}/"

LAYERSERIES_COMPAT_evb-unleashed = "nanbield scarthgap"
BBFILE_PATTERN_IGNORE_EMPTY_evb-unleashed = "1"
```

## meta-evb/meta-evb-starfive/conf/layer.conf
```bitbake
# We have a conf and classes directory, add to BBPATH
BBPATH .= ":${LAYERDIR}"

BBFILE_COLLECTIONS += "evb-starfive"
BBFILE_PATTERN_evb-starfive = ""
BBFILE_PATTERN_IGNORE_EMPTY_evb-starfive =  "1"
LAYERSERIES_COMPAT_evb-starfive = "langdale mickledore"
```

## meta-evb/meta-evb-starfive/meta-evb-visionfive/conf/layer.conf
```bitbake
# We have a conf and classes directory, add to BBPATH
BBPATH .= ":${LAYERDIR}"

BBFILE_COLLECTIONS += "evb-visionfive"
BBFILE_PATTERN_evb-visionfive = ""

LAYERSERIES_COMPAT_evb-visionfive = "langdale mickledore"
```

## meta-evb/meta-evb-starfive/meta-evb-visionfive2/conf/machine/visionfive2.conf
```bitbake
#@TYPE: Machine
#@NAME: visionfive2
#@SOC: StarFive JH7110
#@DESCRIPTION: Machine configuration for the VisionFive 2 board

require conf/machine/JH7110.inc
require conf/machine/starfive.inc
require conf/machine/include/obmc-evb-common.inc

MACHINE_FEATURES += "\
        obmc-chassis-state-mgmt \
        obmc-host-state-mgmt \
        obmc-bmc-state-mgmt \
        "

PREFERRED_PROVIDER_virtual/obmc-chassis-mgmt = "packagegroup-starfive-apps"
PREFERRED_PROVIDER_virtual/obmc-system-mgmt = "packagegroup-starfive-apps"
PREFERRED_PROVIDER_virtual/obmc-flash-mgmt = "packagegroup-starfive-apps"

RISCV_SBI_FDT ?= "jh7110-visionfive-v2.dtb"

KERNEL_DEVICETREE ?= "starfive/jh7110-visionfive-v2.dtb"

## Do not update fstab file when using wic images
WIC_CREATE_EXTRA_ARGS ?= "--no-fstab-update"

UBOOT_MACHINE = "starfive_visionfive2_defconfig"

UBOOT_DTB_BINARY = "starfive_visionfive2.dtb"

## wic default support
WKS_FILE_DEPENDS ?= " \
    opensbi \
    e2fsprogs-native \
    bmap-tools-native \
"

IMAGE_BOOT_FILES ?= " \
    fw_payload.bin \
    ${KERNEL_IMAGETYPE} \
    ${RISCV_SBI_FDT}  \
    boot.scr.uimg \
    vf2_uEnv.txt \
"

WKS_FILE ?= "visionfive2.wks"
```
